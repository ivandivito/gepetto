/*
 * spi.inc
 *
 *  Created: 08/11/2015 04:15:52 p.m.
 *   Author: ivan
 */ 
 
.IFNDEF SPI_INC
.EQU SPI_INC = 0
 
	.DEF SPI_INC_TEMP = R16

	.DEF SPI_IN_OUT_REG = R17

	.DEF SPI_SD_CMD_REG = R2
	.DEF SPI_SD_CMD_ARG_REG_1 = R3 ;MS
	.DEF SPI_SD_CMD_ARG_REG_2 = R4
	.DEF SPI_SD_CMD_ARG_REG_3 = R5
	.DEF SPI_SD_CMD_ARG_REG_4 = R6 ;LS
	.DEF SPI_SD_CMD_RSP_REG = R17

	.DEF SPI_SD_RX_BLOCK_INDEX_REG = R7

	.DEF SPI_SD_TX_BLOCK_INDEX_REG = R7

	.EQU GO_IDLE_STATE				 = 0
	.EQU SEND_OP_COND				 = 1
	.EQU SEND_IF_COND				 = 8
	.EQU SEND_CSD					 = 9
	.EQU STOP_TRANSMISSION			 = 12
	.EQU SEND_STATUS				 = 13
	.EQU SET_BLOCK_LEN				 = 16
	.EQU READ_SINGLE_BLOCK			 = 17
	.EQU READ_MULTIPLE_BLOCKS		 = 18
	.EQU WRITE_SINGLE_BLOCK			 = 24
	.EQU WRITE_MULTIPLE_BLOCKS		 = 25
	.EQU ERASE_BLOCK_START_ADDR		 = 32
	.EQU ERASE_BLOCK_END_ADDR		 = 33
	.EQU ERASE_SELECTED_BLOCKS		 = 38
	.EQU SD_SEND_OP_COND			 = 41   
	.EQU APP_CMD					 = 55
	.EQU READ_OCR					 = 58
	.EQU CRC_ON_OFF					 = 59

	.EQU SD_CMD_MASK				 = 0x40
	.EQU SD_CMD_RSP_WRITE_OK_MASK	 = 0x1f

	.EQU SD_CMD_IF_END				 = 0x87
	.EQU SD_CMD_END					 = 0x95

	.EQU SD_CMD_RSP_WAIT			 = 0xff
	.EQU SD_CMD_RSP_IDLE			 = 0x01
	.EQU SD_CMD_RSP_NOT_IDLE		 = 0x00
	.EQU SD_CMD_RSP_START			 = 0xfe
	.EQU SD_CMD_RSP_WRITE_OK		 = 0x05


	

	
	


	.MACRO SPI_SD_TX_CMD_MACRO ; 0 es el comando 1 byte , 1 es el argumento 4 bytes y 2 es la respuesta esperada 1 byte

			LDI SPI_INC_TEMP,LOW(@0)
			MOV SPI_SD_CMD_REG,SPI_INC_TEMP
			LDI SPI_INC_TEMP,LOW(@1)
			MOV SPI_SD_CMD_ARG_REG_1,SPI_INC_TEMP
			LDI SPI_INC_TEMP,BYTE2(@1)
			MOV SPI_SD_CMD_ARG_REG_2,SPI_INC_TEMP
			LDI SPI_INC_TEMP,BYTE3(@1)
			MOV SPI_SD_CMD_ARG_REG_3,SPI_INC_TEMP
			LDI SPI_INC_TEMP,BYTE4(@1)
			MOV SPI_SD_CMD_ARG_REG_4,SPI_INC_TEMP
			CALL SPI_SD_TX_CMD
	
	.ENDMACRO


	.MACRO SPI_SD_TX_CMD_REP_MACRO ; 0 es el comando 1 byte , 1 es el argumento 4 bytes y 2 es la respuesta esperada 1 byte

		SPI_SD_TX_CMD_REP_LOOP:
			SPI_SD_TX_CMD_MACRO (@0), (@1)

			CPI SPI_SD_CMD_RSP_REG,(@2)
			BRNE SPI_SD_TX_CMD_REP_LOOP
	
	.ENDMACRO

	

.ENDIF